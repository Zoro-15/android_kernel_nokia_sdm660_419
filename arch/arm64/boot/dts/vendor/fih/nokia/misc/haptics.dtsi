&spmi_bus {
	qcom,pm660@1 {
		/delete-node/ qcom,haptic@c000;
		pm660_haptics: qcom,haptics@c000 {
			compatible = "qcom,qpnp-haptics";
			reg = <0xc000 0x100>;
			interrupts = <0x1 0xc0 0x0 IRQ_TYPE_EDGE_BOTH>,
				     <0x1 0xc0 0x1 IRQ_TYPE_EDGE_BOTH>;
			interrupt-names = "hap-sc-irq", "hap-play-irq";
			qcom,pmic-revid = <&pm660_revid>;
			qcom,pmic-misc = <&pm660_misc>;
			qcom,misc-clk-trim-error-reg = <0xf3>;
			qcom,actuator-type = <1>;
			qcom,play-mode = "direct";
			qcom,vmax-mv = <3248>;
			qcom,ilim-ma = <800>;
			qcom,wave-shape = "square";
			qcom,wave-play-rate-us = <6667>;
			qcom,int-pwm-freq-khz = <1>;
			qcom,sc-dbc-cycles = <8>;
			qcom,en-brake;
			qcom,brake-pattern = <0x3 0x3 0x0 0x0>;
			qcom,lra-high-z = "opt0";
			qcom,lra-auto-res-mode = "qwd";
			qcom,lra-calibrate-at-eop = <0>;
			qcom,correct-lra-drive-freq;///check if needed
		};
	};
};
