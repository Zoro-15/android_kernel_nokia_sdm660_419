## drivers/input/fingerprint/cdfinger/Kconfig
```kconfig
config FINGERPRINT_CDFINGER
       tristate "Cdfinger driver"
       default n
       help
          This is a Cdfinger chipset Driver.
```

## drivers/input/fingerprint/elan/Kconfig
```kconfig
#
# Configuration for ELAN
#

config FINGERPRINT_614R
	bool "ELAN 614R Driver" 
	default n
	---help---
	  This is a ELAN 614R chipset Driver.
```

## drivers/input/fingerprint/goodix_gf5288/Kconfig
```kconfig
#
# Configuration for Goodix GF5288
#

config FINGERPRINT_GF5288
	bool "Goodix GF5288 Driver"
	default n
	help
	  This is a Goodix GF5288 chipset Driver.
```

## drivers/input/fingerprint/sunwave/Kconfig
```kconfig
config FINGERPRINT_SUNWAVE
        bool "Sunwave Driver"
        default n
        help
          This is a Sunwave chipset Driver.
```

## drivers/input/touchscreen/focaltech_touch_fih/Kconfig
```kconfig
#
# Focaltech Touchscreen driver configuration
#

config TOUCHSCREEN_FTS_FIH
        bool "Focaltech Touchscreen"
		depends on I2C
		default n
		help
		  Say Y here if you have Focaltech touch panel.
		  If unsure, say N.

config TOUCHSCREEN_FTS_FIH_TESTS
        bool "Focaltech Touchscreen"
		depends on TOUCHSCREEN_FTS_FIH
		default n
		help
		  Say Y here if you have Focaltech touch panel.
		  If unsure, say N.

config TOUCHSCREEN_FTS_FIH_DIRECTORY
    string "Focaltech ts directory name"
    default "focaltech_touch_fih"
    depends on TOUCHSCREEN_FTS_FIH
    
```

## drivers/input/touchscreen/focaltech_touch_lc/Kconfig
```kconfig
#
# Focaltech Touchscreen driver configuration
#

config TOUCHSCREEN_FTS_LC
    bool "Focaltech Touchscreen for Longcheer devices"
    default n
    help
      Say Y here if you have Focaltech touch panel for Longcheer devices.
      If unsure, say N.
      
config TOUCHSCREEN_FTS_DIRECTORY
    string "Focaltech ts directory name"
    default "focaltech_touch"
    depends on TOUCHSCREEN_FTS
```

## drivers/video/Kconfig
```kconfig
#
# Video configuration
#

menu "Graphics support"

if HAS_IOMEM

config HAVE_FB_ATMEL
	bool

config BOOST_NT50356
        tristate "Boost and WLED Driver for BOOST_NT50356"
        depends on I2C
        select REGMAP_I2C
        help
          This supports NOVATEK BOOST_NT50356 Boost Converter and WLED driver

source "drivers/char/agp/Kconfig"

source "drivers/gpu/vga/Kconfig"

source "drivers/gpu/host1x/Kconfig"
source "drivers/gpu/ipu-v3/Kconfig"

source "drivers/gpu/drm/Kconfig"

menu "Frame buffer Devices"
source "drivers/video/fbdev/Kconfig"
endmenu

source "drivers/video/backlight/Kconfig"

config VGASTATE
       tristate
       default n

config VIDEOMODE_HELPERS
	bool

config HDMI
	bool

endif # HAS_IOMEM

if VT
	source "drivers/video/console/Kconfig"
endif

if FB || SGI_NEWPORT_CONSOLE
	source "drivers/video/logo/Kconfig"

endif


endmenu
```
